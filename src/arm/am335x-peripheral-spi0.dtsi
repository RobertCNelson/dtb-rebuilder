/*
 * Copyright (C) 2015 Mirko Denecke <mirkix@gmail.com>
 *
 * This program is free software; you can redistribute it and/or modify
 * it under the terms of the GNU General Public License version 2 as
 * published by the Free Software Foundation.
 */

&spi0 {
	pinctrl-names = "default";

	status = "okay";
};
