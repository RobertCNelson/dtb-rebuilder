/*
 * Copyright (C) 2015 Mirko Denecke <mirkix@gmail.com>
 *
 * This program is free software; you can redistribute it and/or modify
 * it under the terms of the GNU General Public License version 2 as
 * published by the Free Software Foundation.
 */

#include <dt-bindings/board/am335x-bbw-bbb-base.h>
#include "am335x-peripheral-spi1.dtsi"

&am33xx_pinmux {
	spi1_pins: pinmux_spi1_pins {
		pinctrl-single,pins = <
			/* P9_31: mcasp0_aclkx.spi1_sclk */
			BONE_P9_31 (PIN_INPUT_PULLUP | MUX_MODE3)

			/* P9_29: mcasp0_fsx.spi1_d0 */
			BONE_P9_29 (PIN_INPUT_PULLUP | MUX_MODE3)

			/* P9_30: mcasp0_axr0.spi1_d1 */
			BONE_P9_30 (PIN_OUTPUT_PULLUP | MUX_MODE3)

			/* P9_28: mcasp0_ahclkr.spi1_cs0 */
			BONE_P9_28 (PIN_OUTPUT_PULLUP | MUX_MODE3)

			/* P9_19: uart1_rtsn.spi1_cs1 */
/*			BONE_P9_19 (PIN_OUTPUT_PULLUP | MUX_MODE4)*/

			/* P9_42: ecap0_in_pwm0_out.spi1_cs1 */
			BONE_P9_42A (PIN_OUTPUT_PULLUP | MUX_MODE2)
		>;
	};
};

&spi1 {
	pinctrl-0 = <&spi1_pins>;
};
