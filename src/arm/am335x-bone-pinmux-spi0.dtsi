/*
 * Copyright (C) 2015 Mirko Denecke <mirkix@gmail.com>
 *
 * This program is free software; you can redistribute it and/or modify
 * it under the terms of the GNU General Public License version 2 as
 * published by the Free Software Foundation.
 */

#include <dt-bindings/board/am335x-bbw-bbb-base.h>
#include "am335x-peripheral-spi0.dtsi"

&am33xx_pinmux {
	spi0_pins: pinmux_spi0_pins {
		pinctrl-single,pins = <
			/* P9_22: spi0_sclk.spi0_sclk */
			BONE_P9_22 (PIN_INPUT_PULLUP | MUX_MODE0)
			/* P9_21: spi0_d0.spi0_d0 */
			BONE_P9_21 (PIN_INPUT_PULLUP | MUX_MODE0)
			/* P9_18: spi0_d1.spi0_d1 */
			BONE_P9_18 (PIN_OUTPUT_PULLUP | MUX_MODE0)
			/* P9_17: spi0_cs0.spi0_cs0 */
			BONE_P9_17 (PIN_OUTPUT_PULLUP | MUX_MODE0)
		>;
	};
};

&spi0 {
	pinctrl-0 = <&spi0_pins>;

	spi0_0 {
		#address-cells = <1>;
		#size-cells = <0>;
		spi-max-frequency = <24000000>;
		reg = <0>;
		compatible = "spidev";
	};
};
